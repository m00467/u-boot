## configs/mt6771_defconfig
```kconfig
CONFIG_ARM=y
CONFIG_SYS_BOARD="pda"
CONFIG_SKIP_LOWLEVEL_INIT=y
CONFIG_COUNTER_FREQUENCY=13000000
CONFIG_POSITION_INDEPENDENT=y
# CONFIG_INIT_SP_RELATIVE is not set
CONFIG_GIC_V3_ITS=y
CONFIG_GICV3_SUPPORT_GIC600=y
CONFIG_ARM_SMCCC=y
CONFIG_ARCH_MEDIATEK=y
CONFIG_TEXT_BASE=0x40080000
CONFIG_SYS_MALLOC_LEN=0x180000
CONFIG_SYS_MALLOC_F_LEN=0x1000
CONFIG_ENV_SOURCE_FILE="arch/arm/mach-mediatek/mt6771/default.env"
CONFIG_NR_DRAM_BANKS=1
CONFIG_HAS_CUSTOM_SYS_INIT_SP_ADDR=y
CONFIG_CUSTOM_SYS_INIT_SP_ADDR=0x41fffef0
CONFIG_ENV_SIZE=0x750
CONFIG_DM_GPIO=y
CONFIG_DEFAULT_DEVICE_TREE="mt6771-nokia-pda"
CONFIG_MTK_MEM_MAP_DDR_SIZE=0x80000000
CONFIG_MTK_MEM_MAP_MMIO_SIZE=0x40000000
CONFIG_SYS_LOAD_ADDR=0x47000000
# CONFIG_PSCI_RESET is not set
CONFIG_ARMV8_UDELAY_EVENT_STREAM=y
CONFIG_ARMV8_CRYPTO=y
CONFIG_ARMV8_CE_SHA256=y
CONFIG_LOCALVERSION="-mt6771"
# CONFIG_LOCALVERSION_AUTO is not set
CONFIG_CC_OPTIMIZE_FOR_SPEED=y
CONFIG_OPTIMIZE_INLINING=y
CONFIG_LTO=y
CONFIG_ENV_VARS_UBOOT_CONFIG=y
# CONFIG_SYS_MALLOC_CLEAR_ON_INIT is not set
CONFIG_SKIP_EARLY_DM=y
CONFIG_STACK_SIZE=0x200000
# CONFIG_EFI_LOADER is not set
# CONFIG_BOOTSTD is not set
# CONFIG_LEGACY_IMAGE_FORMAT is not set
CONFIG_BOOTDELAY=3
CONFIG_AUTOBOOT_MENU_SHOW=y
# CONFIG_ARCH_FIXUP_FDT_MEMORY is not set
CONFIG_USE_BOOTARGS=y
CONFIG_USE_BOOTCOMMAND=y
CONFIG_SAVE_PREV_BL_FDT_ADDR=y
CONFIG_LOGLEVEL=6
# CONFIG_CONSOLE_FLUSH_SUPPORT is not set
CONFIG_SYS_CONSOLE_INFO_QUIET=y
CONFIG_SYS_STDIO_DEREGISTER=y
# CONFIG_SYS_DEVICE_NULLDEV is not set
# CONFIG_DISPLAY_CPUINFO is not set
# CONFIG_DISPLAY_BOARDINFO is not set
# CONFIG_BOARD_INIT is not set
CONFIG_BOARD_LATE_INIT=y
CONFIG_HUSH_PARSER=y
# CONFIG_CMDLINE_EDITING is not set
# CONFIG_AUTO_COMPLETE is not set
# CONFIG_SYS_LONGHELP is not set
# CONFIG_SYS_XTRACE is not set
# CONFIG_CMD_BDI is not set
# CONFIG_CMD_CONSOLE is not set
# CONFIG_CMD_HELP is not set
# CONFIG_CMD_BOOTD is not set
# CONFIG_CMD_BOOTI is not set
# CONFIG_BOOTM_PLAN9 is not set
# CONFIG_BOOTM_RTEMS is not set
# CONFIG_BOOTM_VXWORKS is not set
CONFIG_CMD_BOOTMENU=y
# CONFIG_CMD_ELF is not set
# CONFIG_CMD_IMI is not set
# CONFIG_CMD_XIMG is not set
# CONFIG_CMD_EXPORTENV is not set
# CONFIG_CMD_IMPORTENV is not set
# CONFIG_CMD_SAVEENV is not set
# CONFIG_CMD_ENV_EXISTS is not set
# CONFIG_CMD_CRC32 is not set
# CONFIG_CMD_BIND is not set
CONFIG_CMD_FASTBOOT_ABORT_KEYED=y
# CONFIG_CMD_LOADB is not set
# CONFIG_CMD_LOADS is not set
CONFIG_CMD_MMC=y
CONFIG_CMD_MMC_REG=y
# CONFIG_CMD_PINMUX is not set
CONFIG_CMD_READ=y
# CONFIG_CMD_ECHO is not set
# CONFIG_CMD_ITEST is not set
# CONFIG_CMD_SOURCE is not set
# CONFIG_CMD_SETEXPR is not set
# CONFIG_CMD_BLOCK_CACHE is not set
# CONFIG_CMD_BLKMAP is not set
# CONFIG_CMD_BUTTON is not set
# CONFIG_CMD_CLS is not set
CONFIG_CMD_PAUSE=y
# CONFIG_CMD_SLEEP is not set
# CONFIG_CMD_VIDCONSOLE is not set
# CONFIG_CMD_CYCLIC is not set
CONFIG_CMD_SPAWN_NUM_JOBS=8
CONFIG_DOS_PARTITION=y
CONFIG_EFI_PARTITION=y
# CONFIG_PARTITION_UUIDS is not set
CONFIG_OF_LIVE=y
CONFIG_ENV_USE_DEFAULT_ENV_TEXT_FILE=y
CONFIG_ENV_DEFAULT_ENV_TEXT_FILE="arch/arm/mach-mediatek/mt6771/default.env"
CONFIG_NO_NET=y
# CONFIG_DM_DEVICE_REMOVE is not set
# CONFIG_DM_STDIO is not set
# CONFIG_DM_SEQ_ALIAS is not set
# CONFIG_OF_TRANSLATE is not set
CONFIG_BLKMAP=y
CONFIG_BUTTON_REMAP_PHONE_KEYS=y
CONFIG_BUTTON_MTK_KPD=y
CONFIG_CLK=y
CONFIG_USB_FUNCTION_FASTBOOT=y
CONFIG_FASTBOOT_BUF_ADDR=0x47000000
CONFIG_FASTBOOT_BUF_SIZE=0x7800000
CONFIG_FASTBOOT_FLASH=y
CONFIG_FASTBOOT_FLASH_BLOCK=y
CONFIG_FASTBOOT_FLASH_BLOCK_INTERFACE_NAME="mmc"
CONFIG_FASTBOOT_OEM_RUN=y
# CONFIG_I2C is not set
CONFIG_DM_KEYBOARD=y
CONFIG_BUTTON_KEYBOARD=y
# CONFIG_MMC_QUIRKS is not set
# CONFIG_MMC_HW_PARTITIONING is not set
CONFIG_MMC_IO_VOLTAGE=y
CONFIG_MMC_UHS_SUPPORT=y
CONFIG_MMC_HS200_SUPPORT=y
CONFIG_MMC_SDHCI=y
CONFIG_MMC_SDHCI_SDMA=y
CONFIG_MMC_SDHCI_ADMA=y
CONFIG_MMC_MTK=y
CONFIG_PHY=y
CONFIG_PHY_MTK_TPHY=y
CONFIG_PINCTRL=y
CONFIG_PINCONF=y
CONFIG_PINCTRL_MT8183=y
CONFIG_DM_PMIC=y
CONFIG_DM_PMIC_MTK_PWRAP=y
CONFIG_DM_REGULATOR=y
CONFIG_DM_REGULATOR_FIXED=y
CONFIG_DM_REGULATOR_MT6358=y
CONFIG_BAUDRATE=921600
# CONFIG_SERIAL_PRESENT is not set
CONFIG_DM_SERIAL=y
CONFIG_NULLDEV_SERIAL=y
CONFIG_USB=y
CONFIG_DM_USB_GADGET=y
CONFIG_USB_MTU3=y
CONFIG_USB_GADGET=y
CONFIG_USB_GADGET_MANUFACTURER="mt6771 gadget"
CONFIG_USB_GADGET_VENDOR_NUM=0x0e8d
CONFIG_USB_GADGET_PRODUCT_NUM=0xa4a5
CONFIG_USB_GADGET_VBUS_DRAW=500
CONFIG_VIDEO=y
# CONFIG_VIDEO_LOGO is not set
# CONFIG_BACKLIGHT is not set
CONFIG_VIDEO_COPY=y
# CONFIG_VIDEO_BPP8 is not set
# CONFIG_VIDEO_BPP16 is not set
CONFIG_VIDEO_ANSI=y
CONFIG_SYS_WHITE_ON_BLACK=y
CONFIG_VIDEO_SYNC_MS=300
CONFIG_VIDEO_SYNC_CYCLIC_MS=20
# CONFIG_PANEL is not set
CONFIG_VIDEO_SIMPLE=y
CONFIG_CC_OPTIMIZE_LIBS_FOR_SPEED=y
CONFIG_CIRCBUF=y
CONFIG_LIBAVB=y
CONFIG_MD5=y
# CONFIG_TOOLS_KWBIMAGE is not set
```
